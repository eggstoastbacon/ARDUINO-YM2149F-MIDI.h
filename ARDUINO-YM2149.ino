/*
 * Arduino YM2149 MIDI Synth v0.5
 * 
 * Original code developed by yukimizake.
 * Video demonstration: Soon.
 * Schematics: Soon.
 * Based on re-factored code by Dansfing / dansfing.uk (https://dansfing.uk/YM_v2_1b/YM_MIDI_lib_Screen_buttons/YM_MIDI_lib_Screen_buttons.ino)
 * Updated PCB design and modifications for 2024 by crunchypotato for HobbyChop.
 * OLED display not initially supported in this version but the pins are available on the PCB headers.
 * Replaced 2 samples for Channel 10 with smaller samples.
 * Added comments to playNote code.
 * Remapped velocity 1-127 to 64-127 and implemented velocity examples in MIDI CH. 1 and 4. 
 * Future progress will be in commit messages.
 *
 * This program is free software: you can redistribute it and/or modify
 * it under the terms of the GNU General Public License as published by
 * the Free Software Foundation, either version 3 of the License, or
 * (at your option) any later version.
 *
 * This program is distributed in the hope that it will be useful,
 * but WITHOUT ANY WARRANTY; without even the implied warranty of
 * MERCHANTABILITY or FITNESS FOR A PARTICULAR PURPOSE. See the
 * GNU General Public License for more details.
 *
 * You should have received a copy of the GNU General Public License
 * along with this program. If not, see <http://www.gnu.org/licenses/>.
 */

#include <avr/io.h>
#include <avr/interrupt.h>
#include <Arduino.h>

void playNote(byte note, byte velocity, byte channel, int detune);
void playNoteB(byte note, byte velocity, byte channel, int detune);
void stopNote();
void stopNoteB();

//Port settings
const int ad0 = 8;
const int ad1 = 9;
const int ad2 = 2;
const int ad3 = 3;
const int ad4 = 4;
const int ad5 = 5;
const int ad6 = 6;
const int ad7 = 7;
const int pinBC1 = 10;   
const int pinBDIR = 11;
//BC2 to +5V
const int pinYMReset = 12;

// Buttons on Analogue Pin A1
#define buttonPin A1       // analog input pin to use as a digital input

//banks
bool setBankB;
  
//voicing
byte noteA = 0;
byte noteB = 0;
byte noteC = 0;
int periodA = 0;
int periodB = 0;
int periodC = 0;

//MIDI MUTES
int mm0=0;
int mm1=0;
int mm2=0;
int mm3=0;
int mm4=0;
int mm5=0;
int mm6=0;
int mm7=0;

//envelope
byte AmaxVolume = 0;
byte BmaxVolume = 0;
byte CmaxVolume = 0;

//detune
int detuneValue = 1;
int detuneActiveA = 0;
int detuneActiveB = 0;
int detuneActiveC = 0;

//arpeggio settings
byte pattern1[] = {0, 7, 12};          // Pattern 1: Root, Perfect Fifth, Octave
byte pattern2[] = {12, 7, 0};          // Pattern 2: Octave, Perfect Fifth, Root
byte pattern3[] = {0, 12, 7};          // Pattern 3: Root, Octave, Perfect Fifth
byte pattern4[] = {0, 3, 7};           // Pattern 4: Root, Minor Third, Perfect Fifth
byte pattern5[] = {0, 7, 3};           // Pattern 5: Root, Perfect Fifth, Minor Third
byte pattern6[] = {0, 12, 3};          // Pattern 6: Root, Octave, Minor Third
byte pattern7[] = {0, 5, 7};           // Pattern 7: Root, Perfect Fourth, Perfect Fifth
byte pattern8[] = {0, 4, 7};           // Pattern 8: Root, Major Third, Perfect Fifth
byte pattern9[] = {0, 2, 5};           // Pattern 9: Root, Major Second, Perfect Fourth
byte pattern10[] = {0, 3, 10};         // Pattern 10: Root, Minor Third, Minor Seventh
byte pattern11[] = {0, 4, 8};          // Pattern 11: Root, Major Third, Minor Sixth
byte pattern12[] = {0, 4, 11};         // Pattern 12: Root, Major Third, Major Sixth
byte pattern13[] = {0, 7, 9};          // Pattern 13: Root, Perfect Fifth, Minor Seventh
byte pattern14[] = {0, 5, 11};         // Pattern 14: Root, Perfect Fourth, Major Sixth
byte pattern15[] = {0, 4, 8};          // Pattern 15: Root, Major Third, Augmented Fifth
byte pattern16[] = {0, 9, 12};         // Pattern 16: Root, Major Sixth, Octave


byte* currentPattern = pattern1; // Pointer to the currently active pattern
byte arpeggioLength = sizeof(pattern1); // Length of the active pattern
byte arpeggioCounter = 0;
boolean arpeggioFlipMe = false;
int currentArpNote;
int arpMod = 0;
int octaveOffset = 0;

byte defaultLevel = 10;

//pitch bend
int pitchBendValue = 0;
float pitchBendRange = 16384.0; // multiple of 8192.0, the smaller the more the bend range.

//volume
byte volume;

//velocity
byte velo;
int velocityValue = 127;
int velocityStatus = 0;

//envelop
byte envelopeShape = 0;
const byte envelopeShapes[] = {
};

//short notes
int noteLength = 100;
int noteLengthDelay = 0;

//vibrato
int vibratoRate = 0;
int vibratoDepth = 0; 
int vibratoCounter = 0;
boolean vibratoOn = false;

//note activity
int noteActiveA = 0;
int noteActiveB = 0;
int noteActiveC = 0;

//cc Controls
int controlValue1;
int controlValue2;
int controlValue3;
int controlValue4;
int controlValue5;
int controlValue6;
int controlValue7;
int controlValue8;
int controlValue9;
int controlValue10;

//Fast pin switching macros
//#define CLR(x,y) (x&=(~(1<<y)))
//#define SET(x,y) (x|=(1<<y))
//#define SET(PORT, PIN) ((PORT) |= (1 << (PIN)))
//#define CLR(PORT, PIN) ((PORT) &= ~(1 << (PIN)))

void setPinHigh(volatile uint8_t &port, uint8_t pin) {
    asm volatile(
        "sbi %[port], %[pin]"
        : // No output
        : [port] "I" (_SFR_IO_ADDR(port)), [pin] "I" (pin)
    );
}

void setPinLow(volatile uint8_t &port, uint8_t pin) {
    asm volatile(
        "cbi %[port], %[pin]"
        : // No output
        : [port] "I" (_SFR_IO_ADDR(port)), [pin] "I" (pin)
    );
}

#define __BCPORT__ PORTB
#define __BC1__ 2
#define __BDIR__ 3

#define __LEDPORT__ PORTB
#define __LED__ 5

#define CLEAR(port, pin) (port &= ~(1 << pin))

const int ledPin = 13;

const int tp[] = {0, 0, 0, 0, 0, 0, 0, 0, 0, 0, 0, 4050,
                   3822, 3608, 3405, 3214, 3034, 2863, 2703, 2551, 2408, 2273, 2145, 4050, 3822,
                   3608, 3405, 3214, 3034, 2863, 2703, 2551, 2408, 2273, 2145, 2025, 1911, 1804, 1703,
                   1607, 1517, 1432, 1351, 1276, 1204, 1136, 1073, 1012, 956, 902, 851, 804, 758,
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                   12, 11, 11, 10 };

// Samples C3-E3                   
                   
const int envTp[] = {3822, 3608, 3405, 3214, 3034, 2863, 2703, 2551, 2408, 2273, 2145, 2025, 1911,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 3, 2};

PROGMEM const char s0[] = {13, 14, 14, 13, 14, 15, 12, 14, 10, 14, 12, 14, 14,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 11, 10};
const int s0Length = 931;
PROGMEM const char s1[] = {13, 14, 14, 14, 14, 14, 14, 13, 14, 14, 14, 13, 14,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 14, 13};
const int s1Length = 1780;
PROGMEM const char s2[] = {15, 13, 12, 13, 13, 14, 13, 15, 14, 13, 14, 13, 13,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 13, 13};
const int s2Length = 463;
PROGMEM const char s3[] = {7, 6, 7, 7, 8, 8, 8, 8, 9, 9, 9, 10, 10,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 8, 8};
const int s3Length = 2982;
PROGMEM const char s4[] = {0, 0, 0, 0, 0, 0, 0, 15, 15, 15, 15, 15, 15,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 0, 0};
const int s4Length = 741;
//const char* samplePointers[] = {s0, s1, s2, s3, s4};
//int sampleLength[] = {931,1780,463,8011,2869};
 
//Timer
const char* sampleOffset;
int sampleCounter = 0;
int sampleLength = 0;
int timerTicks = 0;

bool toggleVibrato = true; // Initialize toggle variable

ISR(TIMER1_COMPA_vect)
{
  timerTicks++;
  if (sampleCounter < sampleLength) {
    send_data(0x0A, pgm_read_byte_near(sampleOffset + sampleCounter++));
  }

  if (controlValue2 == 0) {
    vibratoCounter = 0;
    vibratoDepth = 0;
    vibratoRate = 0;
  }

 int modulatedPeriodA;
 int modulatedPeriodB;
 int modulatedPeriodC;

int vibratoOffset = vibratoDepth * sin(vibratoCounter * vibratoRate);
  
  if (toggleVibrato) {
    // Handle vibrato for each active note
    if (noteActiveA && controlValue2 >= 1) {
        float pitchBendFactor = pow(2.0, pitchBendValue / pitchBendRange);
        vibratoOffset = vibratoDepth * sin(vibratoCounter * vibratoRate);
                if (controlValue5 == 0) { 
        modulatedPeriodA = ((tp[noteA]  + detuneValue) + vibratoOffset) / pitchBendFactor; } else { 
        modulatedPeriodA = ((tp[currentArpNote] + detuneValue) + vibratoOffset);  
        }
        send_data(0x00, modulatedPeriodA & 0xFF);
        send_data(0x01, (modulatedPeriodA >> 8) & 0x0F);
        vibratoCounter += vibratoRate;
        if (vibratoCounter >= 360) vibratoCounter -= 360;  // Reset to prevent overflow
    }

    else if (noteActiveB && controlValue2 >= 1) {
        float pitchBendFactor = pow(2.0, pitchBendValue / pitchBendRange);
        vibratoOffset = vibratoDepth * sin(vibratoCounter * vibratoRate);
                if (controlValue5 == 0) { 
        modulatedPeriodB = ((tp[noteB] + detuneValue) + vibratoOffset) / pitchBendFactor; } else { 
        modulatedPeriodB = ((tp[currentArpNote] + detuneValue) + vibratoOffset);  
        }
        send_data(0x02, modulatedPeriodB & 0xFF);
        send_data(0x03, (modulatedPeriodB >> 8) & 0x0F);
        vibratoCounter += vibratoRate;
        if (vibratoCounter >= 360) vibratoCounter -= 360;  // Reset to prevent overflow
    }

    else if (noteActiveC && controlValue2 >= 1) {
        float pitchBendFactor = pow(2.0, pitchBendValue / pitchBendRange);
        vibratoOffset = vibratoDepth * sin(vibratoCounter * vibratoRate);
        if (controlValue5 == 0) { 
        modulatedPeriodC = ((tp[noteC]  + detuneValue) + vibratoOffset) / pitchBendFactor; } else { 
        modulatedPeriodC = ((tp[currentArpNote]  + detuneValue) + vibratoOffset);  
        }
        send_data(0x04, modulatedPeriodC & 0xFF);
        send_data(0x05, (modulatedPeriodC >> 8) & 0x0F);
        vibratoCounter += vibratoRate;
        if (vibratoCounter >= 360) vibratoCounter -= 360;  // Reset to prevent overflow
    }
    
    if (vibratoCounter >= 360) vibratoCounter -= 360;
  } else {
    // Handle arpeggio for each active note
    int arpeggioSpeed = map(controlValue5, 0, 127, 50, 1);

if (timerTicks >= arpeggioSpeed) {
  timerTicks = 0;

  if (noteActiveA && controlValue5 >= 1) {
float pitchBendFactor = pow(2.0, pitchBendValue / pitchBendRange);
int adjustedNoteA = (noteA + octaveOffset) / pitchBendFactor;
int indexA = adjustedNoteA + currentPattern[arpeggioCounter];
    periodA = tp[indexA]; 
    currentArpNote = indexA;

    byte LSB = (periodA & 0x00FF); // Get the LSB of the period
    byte MSB = ((periodA & 0x0F00) >> 8); // Get the MSB of the period
    send_data(0x00, periodA & 0xFF);
    send_data(0x01, (periodA >> 8) & 0x0F);
    if (controlValue7 > 64) send_data(0x08, volume);
  }

  else if (noteActiveB && controlValue5 >= 1) {
    float pitchBendFactor = pow(2.0, pitchBendValue / pitchBendRange);
    int adjustedNoteB = (noteB + octaveOffset) / pitchBendFactor;
    int indexB = adjustedNoteB + currentPattern[arpeggioCounter];
    periodB = tp[indexB]; 
    currentArpNote = indexB;

    byte LSB = (periodB & 0x00FF);
    byte MSB = ((periodB >> 8) & 0x000F);
    send_data(0x02, periodB & 0xFF);
    send_data(0x03, (periodB >> 8) & 0x0F);
    if (controlValue7 > 64) send_data(0x09, volume);
  }

  else if (noteActiveC && controlValue5 >= 1) {
    float pitchBendFactor = pow(2.0, pitchBendValue / pitchBendRange);
    int adjustedNoteC = (noteC + octaveOffset) / pitchBendFactor;
    int indexC = adjustedNoteC + currentPattern[arpeggioCounter];
    periodC = tp[indexC]; 
    currentArpNote = indexC;

    byte LSB = (periodC & 0x00FF);
    byte MSB = ((periodC >> 8) & 0x000F);
    send_data(0x04, periodC & 0xFF);
    send_data(0x05, (periodC >> 8) & 0x0F);
    if (controlValue7 > 64) send_data(0x0A, volume);
  }
      
      arpeggioCounter++;
      if (arpeggioCounter == arpeggioLength) arpeggioCounter = 0;
    }
 }

  // Toggle between vibrato and arpeggio on each interrupt
  toggleVibrato = !toggleVibrato;

 // if (timerTicks > 255) {
 //   timerTicks = 0;
 // }
}

ISR(TIMER2_COMPA_vect) {
  if (sampleCounter < sampleLength) //send current sample
  {
    send_data(0x0A, pgm_read_byte_near(sampleOffset + sampleCounter++));
  }
}

bool setupOCR1A = false;


void setup(){
  //init pins
  pinMode(ad0, OUTPUT);
  pinMode(ad1, OUTPUT);
  pinMode(ad2, OUTPUT);
  pinMode(ad3, OUTPUT);
  pinMode(ad4, OUTPUT);
  pinMode(ad5, OUTPUT);
  pinMode(ad6, OUTPUT);
  pinMode(ad7, OUTPUT);
  pinMode(pinBC1, OUTPUT);
  pinMode(pinBDIR, OUTPUT);
  pinMode(pinYMReset, OUTPUT);
  pinMode(ledPin, OUTPUT);
  pinMode(buttonPin, INPUT);
  
  resetYM();
  
  AmaxVolume = defaultLevel;
  BmaxVolume = defaultLevel;
  CmaxVolume = defaultLevel;
  
  //serial init
  Serial.begin(31250);
    // Start the MIDI output serial port
  
  //timer1 : sample player
  cli();
  TCCR1A = 0;           // Reset Timer1 Control Register A
  TCCR1B = 0;           // Reset Timer1 Control Register B
  OCR1A = 1250;        // Set compare value for a ~1 Hz frequency with 256 prescaler (adjust as needed)
  TCCR1B |= (1 << WGM12); // Enable CTC mode
  TCCR1B |= (1 << CS12);  // Set prescaler to 256
  TCCR1B |= (1 << CS10);  // Set prescaler to 256
  TIMSK1 |= (1 << OCIE1A); // Enable Timer1 compare interrupt
  
  // Sample timer settings need to be slower than what the other timer runs at
  TCCR2A = 0;
  TCCR2B = 0; 
  TCCR2A |= (1 << WGM21); 
  OCR2A = 1450; 
  TIMSK2 |= (1 << OCIE2A);
  TCCR2B |= (1 << CS21); 
  sei();
  
  //say hello
  //This is the bleep played on power on.
      ////note/velo/channel
playNote(78, 127, 1, 0);  // F#5
delay(30);             // Shorter delay for chiptune feel
playNote(76, 127, 1, 0);  // E5
delay(30);
playNote(74, 127, 1, 0);  // D5
delay(30);
playNote(72, 127, 1, 0);  // C5
delay(30);
playNote(70, 127, 1, 0);  // B4
delay(30);
playNote(69, 127, 1, 0);  // A4
delay(30);
playNote(67, 127, 1, 0);  // G4
delay(30);
playNote(65, 127, 1, 0);  // F4
delay(30);
playNote(64, 127, 1, 0);  // E4
delay(30);
playNote(62, 127, 1, 0);  // D4
delay(30);
stopNote(62, 1);       // Stop D4       // Stop D4
}//END OF SETUP

// Main Loop
void loop() {
  byte command = getSerialByte();
  byte commandMSB = command & 0xF0;
  byte midiChannel = command & 0x0F;

  switch (commandMSB) {
    case 0x80: { // Note Off
      byte note = getSerialByte();
      if (setBankB) stopNoteB(note, midiChannel);
      else stopNote(note, midiChannel);
      break;
    }
    
    case 0x90: { // Note On
      byte note = getSerialByte();
      byte velo = getSerialByte();
      setupOCR1AOnce();
      velo = constrainVelocity(velo);
      velocityValue = velo;

      if (midiChannel == 0x09 && velo != 0) {
        playDigidrum(note, velo);
      } else if (velo != 0) {
        if (setBankB) {
          playNoteB(note, velo, midiChannel, pitchBendValue);
          applyNoteLengthDelay(stopNoteB, note, midiChannel);
        } else {
          playNote(note, velo, midiChannel, pitchBendValue);
          applyNoteLengthDelay(stopNote, note, midiChannel);
        }
      } else {
        if (setBankB) stopNoteB(note, midiChannel);
        else stopNote(note, midiChannel);
      }
      break;
    }

    case 0xA0: // Key Pressure
    case 0xC0: // Program Change
    case 0xD0: // Channel Pressure
      getSerialByte(); // Ignore the extra bytes for these commands
      getSerialByte();
      break;

    case 0xB0: // Control Change
      handleControlChange(midiChannel);
      break;

    case 0xE0: // Pitch Bend
      handlePitchBend(midiChannel);
      break;
  }
}

void setupOCR1AOnce() {
  if (!setupOCR1A) {
    cli(); // Disable global interrupts
    OCR1A = 75;
    setupOCR1A = true;
    sei(); // Re-enable global interrupts
  }
}

byte constrainVelocity(byte velo) {
  velo = constrain(velo, 0, 127);
  return (controlValue4 == 0) ? 127 : map(velo, 0, 127, map(controlValue4, 127, 1, 64, 127), 127);
}

void applyNoteLengthDelay(void (*stopFunction)(byte, byte), byte note, byte midiChannel) {
  if (controlValue10 > 0) {
    delay(noteLengthDelay);
    stopFunction(note, midiChannel);
  }
}

void handleControlChange(byte midiChannel) {
  byte controlNumber = getSerialByte();
  byte controlValue = getSerialByte();

  switch (controlNumber) {
    case 1: // Detune
      controlValue1 = controlValue;
      detuneValue = map(controlValue1, 0, 127, -64, 63);
      applyDetuneToActiveNotes(midiChannel);
      break;
    case 2: controlValue2 = controlValue; vibratoRate = map(controlValue2, 1, 127, 1, 10); break;
    case 3: controlValue3 = controlValue; vibratoDepth = map(controlValue3, 1, 127, 0, 12); break;
    case 4: controlValue4 = controlValue; break;
    case 5: controlValue5 = controlValue; break;
    case 6: handlePatternChange(controlValue); break;
    case 7: controlValue7 = controlValue; break;
    case 8: handleOctaveOffset(controlValue); break;
    case 9: setBankB = (controlValue > 64); break;
    case 10: controlValue10 = controlValue; noteLength = map(controlValue, 0, 127, 300, 2000); break;
  }
}

void handlePatternChange(byte controlValue) {
  const byte *patterns[] = {pattern1, pattern2, pattern3, pattern4, pattern5, pattern6, pattern7, pattern8, pattern9, pattern10,
                            pattern11, pattern12, pattern13, pattern14, pattern15, pattern16};
  int patternIndex = controlValue / 8;
  currentPattern = patterns[patternIndex];
  arpeggioLength = sizeof(patterns[patternIndex]);
}

void handleOctaveOffset(byte controlValue) {
  if (controlValue == 0) octaveOffset = 0;
  else if (controlValue <= 21) octaveOffset = -36;
  else if (controlValue <= 43) octaveOffset = -24;
  else if (controlValue <= 63) octaveOffset = -12;
  else if (controlValue <= 84) octaveOffset = 0;
  else if (controlValue <= 105) octaveOffset = 12;
  else if (controlValue <= 126) octaveOffset = 24;
  else octaveOffset = 36;
}

void handlePitchBend(byte midiChannel) {
  setPinHigh(__LEDPORT__, __LED__);
  byte pitchBendLSB = getSerialByte();
  byte pitchBendMSB = getSerialByte();
  pitchBendValue = -(((pitchBendMSB << 7) | pitchBendLSB) - 8192);
  if (noteActiveA) (setBankB ? playNoteB : playNote)(noteA, velocityValue, midiChannel, pitchBendValue);
  if (noteActiveB) (setBankB ? playNoteB : playNote)(noteB, velocityValue, midiChannel, pitchBendValue);
  if (noteActiveC) (setBankB ? playNoteB : playNote)(noteC, velocityValue, midiChannel, pitchBendValue);
  
  CLEAR(__LEDPORT__, __LED__);
}

void applyDetuneToActiveNotes(byte midiChannel) {
  byte notes[] = {noteA, noteB, noteC};
  bool noteActives[] = {noteActiveA, noteActiveB, noteActiveC};
  bool detuneActives[] = {detuneActiveA, detuneActiveB, detuneActiveC};

  for (int i = 0; i < 3; i++) {
    if (noteActives[i] && detuneActives[i]) {
      if (setBankB) playNoteB(notes[i], velocityValue, midiChannel, pitchBendValue);
      else playNote(notes[i], velocityValue, midiChannel, pitchBendValue);
    }
  }
}

void setChannelVolume(byte value, byte chan)
{
  value = (value >> 3) & 0x0F; //downscaling to 4 bits
  
  if (chan == 0)
  {
    AmaxVolume = value;
    send_data(0x08, value);
  }  
  else if (chan == 1)
  {
    BmaxVolume = value;
    send_data(0x09, value);
  }
  else if (chan == 2)
  {
    CmaxVolume = value;
    send_data(0x0A, value);
  } 
}

// Drums
void playDigidrum(byte index, byte velo)
{
  if (index == 64)
  {
    cli();
    
    sampleOffset = s0;
    sampleLength = s0Length;
    sampleCounter = 0;
    sei();
  }
  else if (index == 63)
  {
    cli();
 
    sampleOffset = s1;
    sampleLength = s1Length;
    sampleCounter = 0;
    sei();
  }
  else if (index == 62)
  {
    cli();

    sampleOffset = s2;
    sampleLength = s2Length;
    sampleCounter = 0;
    sei();
  }
  else if (index == 61)
  {
    cli();
 
    sampleOffset = s3;
    sampleLength = s3Length;
    sampleCounter = 0;
    sei();
  }
  else if (index == 60)
  {
    cli();
  
    sampleOffset = s4;
    sampleLength = s4Length;
    sampleCounter = 0;
    sei();
  }
}

void resetYM()
{
    digitalWrite(pinYMReset, LOW);
    digitalWrite(pinYMReset, HIGH);
    delay(1);
    send_data(0x07, 0b00111000);
    for (byte i=0; i <= defaultLevel; i++)
    {
      send_data(0x08, i);
      send_data(0x09, i);
      send_data(0x0A, i);
      delay(1);
    }
}

void send_data(unsigned char address, unsigned char data)
{
  // Temporary array to hold bit values for address and data
  boolean value[8];
  
  // Process and send the address (8 bits)
  for (int i = 0; i < 8; i++) {
    value[i] = ((address & 0x01) == 1);  // Extract the least significant bit
    address >>= 1;  // Right-shift address for the next bit
  }
  
  // Output the address to YM pins
  outputToYM(value);
  
  // Validate the address by setting the control pins
  __BCPORT__ |= (1 << __BDIR__) | (1 << __BC1__);  // Enable address validation
  delayMicroseconds(1);  // Small delay for timing
  __BCPORT__ &= ~((1 << __BDIR__) | (1 << __BC1__));  // Disable address validation

  // Process and send the data (8 bits)
  for (int i = 0; i < 8; i++) {
    value[i] = ((data & 0x01) == 1);  // Extract the least significant bit
    data >>= 1;  // Right-shift data for the next bit
  }

  // Output the data to YM pins
  outputToYM(value);
  
  // Validate the data by setting the control pins
  setPinHigh(__BCPORT__, __BDIR__);  // Activate the data validation signal
  delayMicroseconds(1);  // delay for timing
  setPinLow(__BCPORT__, __BDIR__);   // Deactivate the data validation signal
  
  // Optional: Reset the LED state
  setPinLow(__LEDPORT__, __LED__);
}

void outputToYM(boolean value[])
{
  // Write the bits to the pins
  setPinState(PORTB, 0, value[0]);
  setPinState(PORTB, 1, value[1]);
  setPinState(PORTD, 2, value[2]);
  setPinState(PORTD, 3, value[3]);
  setPinState(PORTD, 4, value[4]);
  setPinState(PORTD, 5, value[5]);
  setPinState(PORTD, 6, value[6]);
  setPinState(PORTD, 7, value[7]);
}

void setPinState(volatile uint8_t &port, uint8_t pin, bool state)
{
  if (state)
    setPinHigh(port, pin);  // Set pin high if state is true
  else
    setPinLow(port, pin);   // Set pin low if state is false
}

byte getSerialByte()
{
  while(Serial.available() < 1) __asm__("nop\n\t");
  return Serial.read();
}
